/*********************************************************************************************************************
* MM32F327X-G8P Opensourec Library 即（MM32F327X-G8P 开源库）是一个基于官方 SDK 接口的第三方开源库
* Copyright (c) 2022 SEEKFREE 逐飞科技
* 
* 本文件是 MM32F327X-G8P 开源库的一部分
* 
* MM32F327X-G8P 开源库 是免费软件
* 您可以根据自由软件基金会发布的 GPL（GNU General Public License，即 GNU通用公共许可证）的条款
* 即 GPL 的第3版（即 GPL3.0）或（您选择的）任何后来的版本，重新发布和/或修改它
* 
* 本开源库的发布是希望它能发挥作用，但并未对其作任何的保证
* 甚至没有隐含的适销性或适合特定用途的保证
* 更多细节请参见 GPL
* 
* 您应该在收到本开源库的同时收到一份 GPL 的副本
* 如果没有，请参阅<https://www.gnu.org/licenses/>
* 
* 额外注明：
* 本开源库使用 GPL3.0 开源许可证协议 以上许可申明为译文版本
* 许可申明英文版在 libraries/doc 文件夹下的 GPL3_permission_statement.txt 文件中
* 许可证副本在 libraries 文件夹下 即该文件夹下的 LICENSE 文件
* 欢迎各位使用并传播本程序 但修改内容时必须保留逐飞科技的版权声明（即本声明）
* 
* 文件名称          main
* 公司名称          成都逐飞科技有限公司
* 版本信息          查看 libraries/doc 文件夹内 version 文件 版本说明
* 开发环境          IAR 8.32.4 or MDK 5.37
* 适用平台          MM32F327X_G8P
* 店铺链接          https://seekfree.taobao.com/
* 
* 修改记录
* 日期              作者                备注
* 2022-08-10        Teternal            first version
* 2024-05-13        AI Assistant        修改为 HC-04 蓝牙模块示例
********************************************************************************************************************/

#include "zf_common_headfile.h"

#include "zf_device_HC_04.h"
// 打开新的工程或者工程移动了位置务必执行以下操作
// 第一步 关闭上面所有打开的文件
// 第二步 project->clean  等待下方进度条走完


// *************************** 例程硬件连接说明 ***************************
// 接入 HC-04 蓝牙模块
//      模块管脚            单片机管脚
//      RX                  查看 zf_device_HC_04.h 中 HC_04_TX_PINx 宏定义 默认 B10
//      TX                  查看 zf_device_HC_04.h 中 HC_04_RX_PINx 宏定义 默认 B11
//      EN                  接高电平或悬空（进入AT模式时需接低电平）
//      STATE               状态指示引脚（可选，连接 HC_04_STATE_PIN 定义引脚）
//      GND                 核心板电源地 GND
//      VCC                 核心板 3.3V 或 5V 电源（根据模块版本）
// 
// 注意：HC-04 模块没有硬件流控(RTS/CTS)，因此发送数据时不需要等待流控信号



// *************************** 例程测试说明 ***************************
// 1.核心板烧录完成本例程
// 
// 2.如果使用主板测试 在断电情况下 将核心板插入主板 HC-04模块插入主板无线模块接口
// 
// 3.如果使用核心板和模块测试 在断电情况下 将核心板与无线模块连接
// 
// 4.通过手机或PC连接HC-04蓝牙模块，打开串口助手（如蓝牙串口APP）并连接
//   连接时可能需要输入配对码（默认"1234"或"0000"），波特率查看 zf_device_HC_04.h 中 
//   HC_04_BAUD_RATE 宏定义，默认9600
// 
// 5.单片机上电复位后 可以在蓝牙串口助手上看到如下串口信息：
//      SEEKFREE HC-04 demo.
// 
// 6.蓝牙串口助手发送数据会收到回复消息，并显示接收到的数据长度
// 
// 如果发现现象与说明严重不符 请参照本文件最下方 例程常见问题说明 进行排查


// **************************** 代码区域 ****************************
#define LED1                    (H2 )

uint8 data_buffer[32];
uint8 data_len;

int main (void)
{
    clock_init(SYSTEM_CLOCK_120M);                                              // 初始化芯片时钟 工作频率为 120MHz
    debug_init();                                                               // 初始化默认 Debug UART

    // 此处编写用户代码 例如外设初始化代码等
    uint8 count = 0;

    gpio_init(LED1, GPO, GPIO_HIGH, GPO_PUSH_PULL);                             // 初始化 LED1 输出 默认高电平 推挽输出模式
    if(hc_04_init(HC_04_BAUD_RATE))                                             // 判断是否通过初始化
    {
        while(1)                                                                // 初始化失败就在这进入死循环
        {
            gpio_toggle_level(LED1);                                            // 翻转 LED 引脚输出电平 控制 LED 亮灭
            system_delay_ms(100);                                               // 短延时快速闪灯表示异常
        }
    }
    hc_04_send_byte('\r');
    hc_04_send_byte('\n');
    hc_04_send_string("SEEKFREE HC-04 demo.\r\n");                              // 初始化正常 输出测试信息
    // 此处编写用户代码 例如外设初始化代码等

    while(1)
    {
        // 此处编写需要循环执行的代码
        data_len = hc_04_read_buffer(data_buffer, 32);                          // 查看是否有消息 默认缓冲区是 HC_04_BUFFER_SIZE 总共 128 字节
        if(0 != data_len)                                                       // 收到了消息 读取函数会返回实际读取到的数据个数
        {
            hc_04_send_buffer(data_buffer, data_len);                           // 将收到的消息发送回去
            memset(data_buffer, 0, 32);
            func_uint_to_str((char *)data_buffer, data_len);
            hc_04_send_string("\r\ndata len:");                                 // 显示实际收到的数据信息
            hc_04_send_buffer(data_buffer, strlen((const char *)data_buffer));  // 显示收到的数据个数
            hc_04_send_string(".\r\n");
        }
        
        // 检查蓝牙连接状态（可选）
        if(hc_04_get_state() == HC_04_STATE_CONNECTED)
        {
            // 已连接，LED正常闪烁
            if(10 < count ++)
            {
                count = 0;
                gpio_toggle_level(LED1);                                        // 翻转 LED 引脚输出电平 控制 LED 亮灭
            }
        }
        else
        {
            // 未连接，LED快速闪烁
            if(5 < count ++)
            {
                count = 0;
                gpio_toggle_level(LED1);                                        // 翻转 LED 引脚输出电平 控制 LED 亮灭
            }
        }
        system_delay_ms(50);
        // 此处编写需要循环执行的代码
    }
}
// **************************** 代码区域 ****************************

// *************************** 例程常见问题说明 ***************************
// 遇到问题时请按照以下问题检查列表检查
// 
// 问题1：蓝牙无法连接或串口没有数据
//      检查HC-04模块的电源是否正确连接（VCC和GND）
//      检查RX/TX线是否正确连接（单片机的TX接模块RX，单片机的RX接模块TX）
//      检查EN引脚是否接高电平（正常模式）或悬空
//      使用AT命令检查模块波特率是否与程序设置一致
//      查看核心板LED灯状态 如果快速闪烁证明初始化失败 检查接线
// 
// 问题2：串口数据乱码
//      检查波特率是否匹配，HC-04默认波特率为9600
//      检查模块AT命令设置的波特率是否与程序初始化波特率一致
// 
// 问题3：发送数据没有收到回复
//      检查蓝牙是否已连接（可以通过STATE引脚或hc_04_get_state()函数判断）
//      调试看看是否读取到数据 data_len 是否一直为0
//      检查模块是否工作正常，尝试使用AT命令测试模块
// 
// 问题4：连接不稳定
//      确保蓝牙模块与手机/PC的距离在有效范围内（通常10米内）
//      检查是否有其他蓝牙设备干扰
//      尝试使用不同的蓝牙串口APP进行测试